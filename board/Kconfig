## board/Kconfig
```kconfig
menu "Hardware Drivers Config"

	config SOC_NRF52832
		bool
		config SOC_NRF52832
		select RT_USING_COMPONENTS_INIT
		select RT_USING_USER_MAIN
		default y

	config SOC_NORDIC
		bool
		config SOC_NORDIC
		default y

	menu "On-chip Peripheral Drivers"
		config BSP_USING_GPIO
			bool "Enable GPIO"
			select RT_USING_PIN
			default y

		config BSP_USING_SAADC
			bool "Enable SAADC"
			select RT_USING_ADC
			default n

		menuconfig BSP_USING_PWM
			bool "Enable PWM"
			select RT_USING_PWM
			default n
			if BSP_USING_PWM
					config BSP_USING_PWM0
						bool "Enable PWM0 bus"
						default y
					if BSP_USING_PWM0
						config BSP_USING_PWM0_CH0
							int "PWM0 channel 0 pin number set"
							range 0 47
							default 17
						config BSP_USING_PWM0_CH1
							int "PWM0 channel 1 pin number set"
							range 0 47
							default 18
						config BSP_USING_PWM0_CH2
							int "PWM0 channel 2 pin number set"
							range 0 47
							default 19
						config BSP_USING_PWM0_CH3
							int "PWM0 channel 3 pin number set"
							range 0 47
							default 20
					endif
					config BSP_USING_PWM1
						bool "Enable PWM1 bus"
						default n
					if BSP_USING_PWM1
						config BSP_USING_PWM1_CH0
							int "PWM1 channel 0 pin number set"
							range 0 47
							default 13
						config BSP_USING_PWM1_CH1
							int "PWM1 channel 1 pin number set"
							range 0 47
							default 14
						config BSP_USING_PWM1_CH2
							int "PWM1 channel 2 pin number set"
							range 0 47
							default 15
						config BSP_USING_PWM1_CH3
							int "PWM1 channel 3 pin number set"
							range 0 47
							default 16
					endif
					config BSP_USING_PWM2
						bool "Enable PWM2 bus"
						default n
					if BSP_USING_PWM2
						config BSP_USING_PWM2_CH0
							int "PWM2 channel 0 pin number set"
							range 0 47
							default 13
						config BSP_USING_PWM2_CH1
							int "PWM2 channel 1 pin number set"
							range 0 47
							default 14
						config BSP_USING_PWM2_CH2
							int "PWM2 channel 2 pin number set"
							range 0 47
							default 15
						config BSP_USING_PWM2_CH3
							int "PWM2 channel 3 pin number set"
							range 0 47
							default 16
					endif
					config BSP_USING_PWM3
						bool "Enable PWM3 bus"
						default n
					if BSP_USING_PWM3
						config BSP_USING_PWM3_CH0
							int "PWM3 channel 0 pin number set"
							range 0 47
							default 13
						config BSP_USING_PWM3_CH1
							int "PWM3 channel 1 pin number set"
							range 0 47
							default 14
						config BSP_USING_PWM3_CH2
							int "PWM3 channel 2 pin number set"
							range 0 47
							default 15
						config BSP_USING_PWM3_CH3
							int "PWM3 channel 3 pin number set"
							range 0 47
							default 16
					endif
			endif

		menuconfig BSP_USING_UART
			bool "Enable UART"
			select RT_USING_SERIAL	
			default y        	
			if BSP_USING_UART
				config BSP_USING_UART0
					bool "Enable UART0"
					default y
					if BSP_USING_UART0
						config BSP_UART0_RX_PIN
							int "uart0 rx pin number"
							range 0 31
							default 8
						config BSP_UART0_TX_PIN
							int "uart0 tx pin number"
							range 0 31
							default 6
					endif
			endif
		menuconfig BSP_USING_UARTE
			bool "Enable UARTE"
			select RT_USING_SERIAL	
			select RT_SERIAL_USING_DMA
			default n        	
			if BSP_USING_UARTE
				config BSP_USING_UART0
					bool "Enable UART0"
					default y
					if BSP_USING_UART0
						config BSP_UART0_RX_PIN
							int "uart0 rx pin number"
							range 0 31
							default 8
						config BSP_UART0_TX_PIN
							int "uart0 tx pin number"
							range 0 31
							default 6
					endif
			endif

		config BSP_USING_I2C
			bool "Enable I2C"
			select RT_USING_I2C
			default n
			if BSP_USING_I2C
				config BSP_USING_I2C0
					bool "Enable I2C0 bus"
					default y
				if BSP_USING_I2C0
					config BSP_I2C0_SCL_PIN
						int "i2c0 scl pin number"
						range 0 31
						default 27
					config BSP_I2C0_SDA_PIN
						int "I2C0 sda pin number"
						range 0 31
						default 26
				endif
				config BSP_USING_I2C1
					bool "Enable I2C1 bus"
					default n
				if BSP_USING_I2C1
					config BSP_I2C1_SCL_PIN
						int "i2c1 scl pin number"
						range 0 31
						default 3
					config BSP_I2C1_SDA_PIN
						int "I2C1 sda pin number"
						range 0 31
						default 2
				endif
			endif

		config BSP_USING_SPI
			bool "Enable SPI"
			select RT_USING_PIN
			default y

			if BSP_USING_SPI
				config BSP_USING_SPI0
					bool "Enable SPI0 bus"
					default y
				if BSP_USING_SPI0
					config BSP_SPI0_SCK_PIN
						int "SPI0 sck pin number set"
						range 0 47
						default 28
					config BSP_SPI0_MOSI_PIN
						int "SPI0 mosi pin number set"
						range 0 47
						default 29
					config BSP_SPI0_MISO_PIN
						int "SPI0 miso pin number set"
						range 0 47
						default 30
					config BSP_SPI0_SS_PIN
						int "SPI0 ss pin number set"
						range 0 47
						default 31
				endif

				config BSP_USING_SPI1
					bool "Enable SPI1 bus"
					default n
				if BSP_USING_SPI1
					config BSP_SPI1_SCK_PIN
						int "SPI0 sck pin number set"
						range 0 47
						default 28
					config BSP_SPI1_MOSI_PIN
						int "SPI0 mosi pin number set"
						range 0 47
						default 29
					config BSP_SPI1_MISO_PIN
						int "SPI0 miso pin number set"
						range 0 47
						default 30
					config BSP_SPI1_SS_PIN
						int "SPI0 ss pin number set"
						range 0 47
						default 31
				endif

				config BSP_USING_SPI2
					bool "Enable SPI2 bus"
					default n
				if BSP_USING_SPI2
					config BSP_SPI2_SCK_PIN
						int "SPI0 sck pin number set"
						range 0 47
						default 28
					config BSP_SPI2_MOSI_PIN
						int "SPI0 mosi pin number set"
						range 0 47
						default 29
					config BSP_SPI2_MISO_PIN
						int "SPI0 miso pin number set"
						range 0 47
						default 30
					config BSP_SPI2_SS_PIN
						int "SPI0 ss pin number set"
						range 0 47
						default 31
				endif

			endif
		config BSP_USING_ON_CHIP_FLASH
			select RT_USING_FAL
			bool "Enable on-chip FLASH"
			default n

		config BSP_USING_ON_CHIP_FS
			bool "Enable on-chip filesystem"
			default n

		menu "On-chip flash config"
			config MCU_FLASH_START_ADDRESS
				hex "MCU FLASH START ADDRESS"
				default 0x00000000

			config MCU_FLASH_SIZE_KB
				int "MCU FLASH SIZE, MAX size 1024 KB"
				range 1 1024
				default 512

			config MCU_SRAM_START_ADDRESS
				hex "MCU RAM START ADDRESS"
				default 0x20000000

			config MCU_SRAM_SIZE_KB
				int "MCU RAM SIZE, MAX size 256 KB"
				range 1 256
				default 64

			config MCU_FLASH_PAGE_SIZE
				hex "MCU FLASH PAGE SIZE, please not change,nrfx default is 0x1000"
				range 0x1000 0x1000
				default 0x1000
		endmenu
		config BSP_USING_WDT
			bool "Enable WDT"
			select RT_USING_WDT
			default n

		menuconfig BSP_USING_ONCHIP_RTC
		bool "Enable RTC"
		select RT_USING_RTC
		default n
		if BSP_USING_ONCHIP_RTC
			config RTC_INSTANCE_ID
			int
			default 2
			config RTC_INSTANCE_ID
				int "select RTC instance id, must be 0, 1, 2"
				range 0 2
				default 2
		endif

		config BSP_USING_TIM
			bool "Enable TIMER"
			select RT_USING_HWTIMER
			default n
			if BSP_USING_TIM
				config BSP_USING_TIM0
					bool "Enable TIMER0"
					default n
				config BSP_USING_TIM1
					bool "Enable TIMER1"
					default n
				config BSP_USING_TIM2
					bool "Enable TIMER2"
					default n
				config BSP_USING_TIM3
					bool "Enable TIMER3"
					default n
				config BSP_USING_TIM4
					bool "Enable TIMER4"
					default n
			endif
	endmenu

	choice
	prompt "BLE STACK"
	default BLE_STACK_USING_NULL
	help
		Select the ble stack

	config BLE_STACK_USING_NULL
		bool "not use the ble stack"

	config  BSP_USING_SOFTDEVICE
		select PKG_USING_NRF5X_SDK
		bool "Nordic softdevice(perpheral)"

	config BSP_USING_NIMBLE
		select PKG_USING_NIMBLE
		select PKG_NIMBLE_BSP_NRF52840
		bool "use nimble stack(iot)"
	endchoice


	choice
	prompt "USING_NRF_DRIVER"
	default USING_RT_DRIVER
	help
		Select the DRIVER IF

	config USING_RT_DRIVER
		bool "using rtthread driver"

	config USING_NRF_DRIVER
		select USINGC_NRF_DRIVER
		bool "use nrf_sdk driver"
	endchoice

	choice
	prompt "USING_NRF_LOG"
	default USING_NONE
	help
		Select the LOG MODULE

	config USING_NONE
		bool "using no log"

	config USING_NRF_LOG
		select USING_NRF_LOG
		bool "use nrf_log module"
		if USING_NRF_LOG
			config USING_NRF_LOG_BACKEND_FLASH
				bool "Enable Flash storage logs"
				default n
			config USING_NRF_LOG_BACKEND_RTT
				bool "Enable RTT print logs"
				default n
			config USING_NRF_LOG_BACKEND_RT_SERIAL
				bool "Enable rtthread serial logs"
				default n
		endif
	endchoice

endmenu
```
